## app/boards/shields/keychron/Kconfig.shield
```kconfig
# Copyright (c) 2020 Pete Johanson
# SPDX-License-Identifier: MIT

config SHIELD_KEYCHRON_B6_UK
    def_bool $(shields_list_contains,keychron_b6_uk)

config SHIELD_KEYCHRON_B6_US
    def_bool $(shields_list_contains,keychron_b6_us)

config SHIELD_KEYCHRON_B6_JIS
    def_bool $(shields_list_contains,keychron_b6_jis)

config SHIELD_KEYCHRON_B1
    bool    

config SHIELD_KEYCHRON_B1_UK
    def_bool $(shields_list_contains,keychron_b1_uk)
    select SHIELD_KEYCHRON_B1

config SHIELD_KEYCHRON_B1_US
    def_bool $(shields_list_contains,keychron_b1_us)
    select SHIELD_KEYCHRON_B1

config SHIELD_KEYCHRON_B1_JIS
    def_bool $(shields_list_contains,keychron_b1_jis)
    select SHIELD_KEYCHRON_B1

config SHIELD_KEYCHRON_B1_US_DEBUG
    def_bool $(shields_list_contains,keychron_b1_us_dbg)
    select SHIELD_KEYCHRON_B1    

config SHIELD_KEYCHRON_B2
    bool    
config SHIELD_KEYCHRON_B2_UK
    def_bool $(shields_list_contains,keychron_b2_uk)
    select SHIELD_KEYCHRON_B2

config SHIELD_KEYCHRON_B2_US
    def_bool $(shields_list_contains,keychron_b2_us)
    select SHIELD_KEYCHRON_B2

config SHIELD_KEYCHRON_B2_JIS
    def_bool $(shields_list_contains,keychron_b2_jis)
    select SHIELD_KEYCHRON_B2

config SHIELD_KEYCHRON_B2_KR
    def_bool $(shields_list_contains,keychron_b2_kr)
    select SHIELD_KEYCHRON_B2    

config SHIELD_KEYCHRON_RGB
    def_bool $(shields_list_contains,keychron_RGB)
```
